## drivers/media/video/tegra/Kconfig
```kconfig
source "drivers/media/video/tegra/avp/Kconfig"
source "drivers/media/video/tegra/mediaserver/Kconfig"

config TEGRA_CAMERA
        bool "Enable support for tegra camera/isp hardware"
        depends on ARCH_TEGRA
        default y
        help
          Enables support for the Tegra camera interface

          If unsure, say Y

config VIDEO_OV5650
        tristate "OV5650 camera sensor support"
        depends on I2C && ARCH_TEGRA
        ---help---
          This is a driver for the Omnivision OV5650 5MP camera sensor
          for use with the tegra isp.

config VIDEO_IMX073
        bool "IMX073 rear camera ISP support"
        depends on I2C && ARCH_TEGRA
        default n
        ---help---
          This is a driver for the FUJITSU M5MO 8MP ISP and SONY camera sensor
          for use with the tegra isp.


config CAMERA_S5K5CCGX
        bool "S5K5CCGX rear camera SOC"
        depends on I2C && ARCH_TEGRA
        default y
        ---help---
          This is a driver for the LSI 3MP SOC camera sensor
          for use with the tegra isp.
config VIDEO_S5K5BBGX
        bool  "S5K5BBGX front camera sensor support"
        depends on I2C && ARCH_TEGRA
        default y
        ---help---
          This is a driver for the S5K5BBGX 2MP camera SOC sensor
          for use with the tegra isp.

config VIDEO_OV2710
        tristate "OV2710 camera sensor support"
        depends on I2C && ARCH_TEGRA
        ---help---
          This is a driver for the Omnivision OV2710 camera sensor
          for use with the tegra isp.

config VIDEO_SOC380
        tristate "SOC380 camera sensor support"
        depends on I2C && ARCH_TEGRA
        ---help---
          This is a driver for the Semco soc380 camera sensor
          for use with the tegra isp.

config TORCH_SSL3250A
        tristate "SSL3250A flash/torch support"
        depends on I2C && ARCH_TEGRA
        ---help---
          This is a driver for the SSL3250A flash/torch camera device

config VIDEO_SH532U
        tristate "SH532U focuser support"
        depends on I2C && ARCH_TEGRA
        ---help---
          This is a driver for the SEMCO SH532U focuser
          for use with the tegra isp.

config VIDEO_AD5820
        tristate "AD5820 focuser support"
        depends on I2C && ARCH_TEGRA
        ---help---
          This is a driver for the AD5820 focuser
          for use with the tegra isp.
```

## drivers/misc/mpu3050/Kconfig
```kconfig
menu "Motion Sensors Support"

choice
    bool "Motion Processing Unit"
    depends on I2C
    default MPU_NONE

config MPU_NONE
    bool "None"
    help
      This disables support for motion processing using the MPU family of
      motion processing units.

config SENSORS_MPU3050
    tristate "MPU3050"
    depends on I2C
    help
      If you say yes here you get support for the MPU3050 Gyroscope driver
      This driver can also be built as a module.  If so, the module
      will be called mpu3050.

config SENSORS_MPU6000
    tristate "MPU6000"
    depends on I2C
    help
      If you say yes here you get support for the MPU6000 Gyroscope driver
      This driver can also be built as a module.  If so, the module
      will be called mpu6000.

endchoice

choice
    prompt "Accelerometer Type"
    depends on SENSORS_MPU3050
    default SENSORS_MPU_BMA150

config SENSORS_MPU_ACCELEROMETER_NONE
    bool "NONE"
    depends on SENSORS_MPU3050 || SENSORS_MPU6000
    help
      This disables accelerometer support for the MPU3050

config SENSORS_MPU_ADXL346
    bool "ADI adxl346"
    depends on SENSORS_MPU3050
    help
      This enables support for the ADI adxl346 accelerometer

config SENSORS_MPU_BMA150
    bool "Bosch BMA150"
    depends on SENSORS_MPU3050
    help
      This enables support for the Bosch BMA150 accelerometer

config SENSORS_MPU_BMA222
    bool "Bosch BMA222"
    depends on SENSORS_MPU3050
    help
      This enables support for the Bosch BMA222 accelerometer

config SENSORS_MPU_KXSD9
    bool "Kionix KXSD9"
    depends on SENSORS_MPU3050
    help
      This enables support for the Kionix KXSD9 accelerometer

config SENSORS_MPU_KXTF9
    bool "Kionix KXTF9"
    depends on SENSORS_MPU3050
    help
      This enables support for the Kionix KXFT9 accelerometer

config SENSORS_MPU_LIS331DLH
    bool "ST lis331dlh"
    depends on SENSORS_MPU3050
    help
      This enables support for the ST lis331dlh accelerometer

config SENSORS_MPU_LSM303DLHA
    bool "ST lsm303dlh"
    depends on SENSORS_MPU3050
    help
      This enables support for the ST lsm303dlh accelerometer

config SENSORS_MPU_MMA8450
    bool "Freescale mma8450"
    depends on SENSORS_MPU3050
    help
      This enables support for the Freescale mma8450 accelerometer

config SENSORS_MPU_MMA8451
    bool "Freescale mma8451"
    depends on SENSORS_MPU3050
    help
      This enables support for the Freescale mma8451 accelerometer

endchoice

choice
    prompt "Compass Type"
    depends on SENSORS_MPU6000 || SENSORS_MPU3050
    default SENSORS_MPU_AK8975

config SENSORS_MPU_COMPASS_NONE
    bool "NONE"
    depends on SENSORS_MPU6000 || SENSORS_MPU3050
    help
      This disables compass support for the MPU6000

config SENSORS_MPU_AK8975
    bool "AKM ak8975"
    depends on SENSORS_MPU6000 || SENSORS_MPU3050
    help
      This enables support for the AKM ak8975 compass

config SENSORS_MPU_MMC314X
    bool "MEMSIC mmc314x"
    depends on SENSORS_MPU3050
    help
      This enables support for the MEMSIC mmc314x compass

config SENSORS_MPU_AMI30X
    bool "Aichi Steel ami30X"
    depends on SENSORS_MPU3050
    help
      This enables support for the Aichi Steel ami304/ami305 compass

config SENSORS_MPU_HMC5883
    bool "Honeywell hmc5883"
    depends on SENSORS_MPU3050
    help
      This enables support for the Honeywell hmc5883 compass

config SENSORS_MPU_LSM303DLHM
    bool "ST lsm303dlh"
    depends on SENSORS_MPU3050
    help
      This enables support for the ST lsm303dlh compass

config SENSORS_MPU_MMC314X
    bool "MEMSIC mmc314xMS"
    depends on SENSORS_MPU3050
    help
      This enables support for the MEMSIC mmc314xMS compass

config SENSORS_MPU_YAS529
    bool "Yamaha yas529"
    depends on SENSORS_MPU3050
    help
      This enables support for the Yamaha yas529 compass

config SENSORS_MPU_HSCDTD00XX
    bool "Alps hscdtd00xx"
    depends on SENSORS_MPU3050
    help
      This enables support for the Alps hscdtd002b/hscdtd004a compass

endchoice

choice
    prompt "Pressure Type"
    depends on SENSORS_MPU6000 || SENSORS_MPU3050
    default SENSORS_MPU_PRESSURE_NONE

config SENSORS_MPU_PRESSURE_NONE
    bool "NONE"
    depends on SENSORS_MPU6000 || SENSORS_MPU3050
    help
      This disables pressure sensor support for the MPU6000

config SENSORS_MPU_BMA085
    bool "Bosch BMA085"
    depends on SENSORS_MPU6000 || SENSORS_MPU3050
    help
      This enables support for the Bosch bma085 pressure sensor

endchoice

config SENSORS_MPU_DEBUG
    bool "MPU debug"
    depends on SENSORS_MPU3050 || SENSORS_MPU6000
    help
      If you say yes here you get extra debug messages from the MPU3050
      and other slave sensors.

config SENSORS_CORE
	tristate "Sensors core"
	help
	  Say Y here to enable debugging messages for power supply class
	  and drivers.
	  
endmenu
```

## drivers/net/wireless/bcm4330/Kconfig
```kconfig
config BCM4330
	default m
	tristate "Broadcom WiFi Driver"
	depends on MMC && !CFG80211
	select WIRELESS_EXT
	select WEXT_PRIV
	---help---
		Select this option to build Broadcom wlan driver
#config BCM_EMBED_FW
#	default n
#	bool "Broadcom Embed FW into WiFi Driver"
#	depends on BROADCOM_WIFI != n
#	---help---
#		Select this option to embed firmware into wlan driver
```

## drivers/samsung/Kconfig
```kconfig
# drivers/samsung/Kconfig
#
#

config SAMSUNG_MODULES
	tristate "Samsung Kernel Modules"
	default n
	help
	  Say Y to enable Samsung kernel modules. j4fs and param
	  modules are included.
	  
config SAMSUNG_PHONE_TTY
	tristate "Samsung CDMA Phone Interface - TTY"
	depends on SAMSUNG_MODULES
	default n
	---help---
	  This is worked for steath-v VIA CDMA modem.
	  The ppp daemon is using the tty interface.
	  When in doubt, say N.

config SAMSUNG_LTE_MODEM_BOOTLOADER
	tristate "Samsung LTE Modem Bootloader - SPI"
	depends on SAMSUNG_MODULES
	default n
	---help---
	  This is worked for CMC220 LTE Modem.
	  The daemon is using the spi interface.
	  When in doubt, say N.

config SAMSUNG_LTE_MODEMCTL 
	tristate "Samsung LTE Modem Control"
	depends on SAMSUNG_MODULES
	default n
	help
	  This is worked for CMC220 LTE Modem.
	  When in doubt, say N.

config SAMSUNG_WTL_FOTA_DPRAM
	tristate "Samsung WTL DPRAM driver for CP FOTA update"
	depends on SAMSUNG_MODULES
	default n
	help
	  This module is needed in recovery image to update CP.
```

## security/tf_driver/Kconfig
```kconfig
config TRUSTED_FOUNDATIONS
	bool "Enable TF Driver"
	default n
	help
	  This option adds kernel support for communication with the Trusted Foundations.
	  If you are unsure how to answer this question, answer N.
```

## sound/soc/tegra/Kconfig
```kconfig
config TEGRA_ALSA
    tristate "Tegra ALSA SoC support"
    select TEGRA_PCM
    select TEGRA_I2S
    select TEGRA_IEC
    select TEGRA_GENERIC_CODEC
    select TEGRA_JACK
    help
       Say Y if you for ALSA SoC support

config TEGRA_PCM
    tristate "Tegra ALSA pcm callbacks"

config TEGRA_I2S
    tristate "Tegra I2S"

config TEGRA_IEC
    tristate "Tegra IEC"

config TEGRA_GENERIC_CODEC
    tristate "Tegra ALSA Generic Codec support"

config TEGRA_JACK
    tristate "Tegra wired accessory jack support"
```
